## MCU/ethernet_test/main/Kconfig
```kconfig
menu "misc config"

config RADIATION_PACKET_NUMBER
    int "Radiation packet number"
    default 150

config RADIATION_PACKET_WAIT_TIME
    int "Radiation wait time (ms)"
    default 100

endmenu

menu "prios and ids"

config HOUSEKEEPING_PACKET_PRIO
    int "Housekeeping task priority"
    default 2

config HOUSEKEEPING_PACKET_ID
    int "Housekeeping task ID"
    default 0

config BITFLIP_PACKET_PRIO
    int "Bitflip task priority"
    default 1

config BITFLIP_PACKET_ID
    int "Bitflip task ID"
    default 1

config RADIATION_PACKET_PRIO
    int "Radiation task priority"
    default 3

config RADIATION_PACKET_ID
    int "Radiation task ID"
    default 2

config ACKNOWLEDGEMENT_PACKET_PRIO
    int "Acknowledgement task priority"
    default 0

config ACKNOWLEDGEMENT_PACKET_ID
    int "Acknowledgement task ID"
    default 3

config CUT_OFF_TC_ID
    int "Cut-off telecommand ID"
    default 3

endmenu

menu "packet size config"

## Data sizes
config ID_SIZE
    int "ID size"
    default 2

config SEQ_COUNTER_SIZE
    int "Sequence counter size"
    default 16

config RTC_SIZE
    int "RTC size"
    default 17

config GNSS_SIZE
    int "GNSS size"
    default 55

config TEMP_SIZE
    int "Temperature size"
    default 96

config ALT_SIZE
    int "Altitude size"
    default 24

config BITFLIP_SIZE
    int "Bitflip size"
    default 172

config RADIATION_SIZE
    int "Radiation size"
    default 256

config TC_SIZE
    int "TC size"
    default 3

config CRC_SIZE
    int "CRC size"
    default 16


## Packet sizes
config HOUSEKEEPING_PACKET_SIZE
    int "Housekeeping packet size"
    default 30

config HOUSEKEEPING_DATA_SIZE
    int "Housekeeping data size"
    default 1024

config BITFLIP_PACKET_SIZE
    int "Bitflip packet size"
    default 29

config BITFLIP_DATA_SIZE
    int "Bitflip data size"
    default 1024

config RADIATION_PACKET_SIZE
    int "Radiation packet size"
    default 40

config RADIATION_DATA_SIZE
    int "Radiation data size"
    default 1024

config ACKNOWLEDGEMENT_PACKET_SIZE
    int "Acknowledgement packet size"
    default 6

config ACKNOWLEDGEMENT_DATA_SIZE
    int "Acknowledgement data size"
    default 42

config TC_DATA_SIZE
    int "Telecommand size"
    default 19

config TC_PACKET_SIZE
    int "Telecommand packet size"
    default 5

endmenu

menu "buffer size config"

config MAX_TC_BUFFER_SIZE
    int "Buffer size"
    default 1024

config MAX_RADIATION_BUFFER_SIZE
    int "Radiation buffer size"
    default 350

endmenu

menu "uart config"

config UART_BAUD_RATE
    int "UART baud rate"
    default 115200

config UART_NUM
    int "UART number"
    range 0 2
    default 1
    help
        UART port number: 0 for UART_NUM_0, 1 for UART_NUM_1, 2 for UART_NUM_2

config TX_PIN
    int "TX pin"
    default 9

config RX_PIN
    int "RX pin"
    default 10

config UART_BUF_SIZE
    int "UART buffer size"
    default 1500

endmenu
#CONFIG_ETH_PHY_SI_PIN = 13
# CONFIG_ETH_PHY_SO_PIN = 4
# CONFIG_ETH_PHY_SCK_PIN = 14
# CONFIG_ETH_PHY_CS_PIN = 15
menu "ethernet config"

    config HOST_IP_ADDR
        string "Host IP address"
        default "192.168.0.165"

    config HOST_PORT
        int "Host port"
        range 1024 65535
        default 8080

    config ETH_MDC_GPIO
        int "ETH MDC GPIO"
        default 23

    config ETH_MDIO_GPIO
        int "ETH MDIO GPIO"
        default 18

    config ETH_PHY_RST_GPIO
        int "ETH PHY reset GPIO"
        default 5

    config ETH_PHY_ADDR
        int "ETH PHY address"
        default 1

    config CONNECTED_BIT
        int "Connected bit"
        default 1

    config ETH_CONNECTION_TMO_MS
        int "Ethernet connection timeout (ms)"
        default 10000
        
    config ETH_BUFFER_SIZE
        int "Ethernet buffer size"
        default 128
        
    config KEEPALIVE_ENABLED
        bool "Enable TCP keep-alive"
        default y

    config KEEPALIVE_IDLE
        int "TCP keep-alive idle time (s)"
        default 5

    config KEEPALIVE_INTERVAL
        int "TCP keep-alive interval time (s)"
        default 5

    config KEEPALIVE_COUNT
        int "TCP keep-alive packet retry count"
        default 3

    config USE_STATIC_IP
        bool "Use static IP"
        default y
    
    config ETH_PHY_SI_PIN
        int "ETH PHY SI GPIO pin number"
        default 13
    
    config ETH_PHY_SO_PIN
        int "ETH PHY SO GPIO pin number"
        default 12
    
    config ETH_PHY_SCK_PIN
        int "ETH PHY SCK GPIO pin number"
        default 14
    
    config ETH_PHY_CS_PIN
        int "ETH PHY CS GPIO pin number"
        default 15

    
endmenu

menu "Storage Configuration"
    config SD_CS_PIN
        int "SD Card CS GPIO pin number"
        default 5
        help
            GPIO pin number used for SD card chip select (CS).
            
    config SD_MOSI_PIN
        int "SD Card MOSI GPIO pin number"
        default 23
        help
            GPIO pin number used for SD card MOSI (Master Out Slave In).
            
    config SD_MISO_PIN
        int "SD Card MISO GPIO pin number"
        default 19
        help
            GPIO pin number used for SD card MISO (Master In Slave Out).
            
    config SD_SCK_PIN
        int "SD Card SCK GPIO pin number"
        default 18
        help
            GPIO pin number used for SD card SCK (Serial Clock).
            
    config SD_CARD_DETECT_PIN
        int "SD Card detect GPIO pin number (optional)"
        default -1
        help
            GPIO pin number used for SD card detect signal. Set to -1 if not used.
            
    config ENABLE_SD_STORAGE
        bool "Enable packet storage on SD card"
        default y
        help
            Enable storing packets to SD card for backup.
endmenu
```

## MCU/ethernet_test/sdkconfig.defaults
```kconfig
# Misc configs
CONFIG_RADIATION_PACKET_NUMBER=150
CONFIG_RADIATION_PACKET_WAIT_TIME=100

# Packet priorities and IDs
CONFIG_HOUSEKEEPING_PACKET_PRIO=2
CONFIG_HOUSEKEEPING_PACKET_ID=0
CONFIG_BITFLIP_PACKET_PRIO=1
CONFIG_BITFLIP_PACKET_ID=1
CONFIG_RADIATION_PACKET_PRIO=3
CONFIG_RADIATION_PACKET_ID=2
CONFIG_ACKNOWLEDGEMENT_PACKET_PRIO=0
CONFIG_ACKNOWLEDGEMENT_PACKET_ID=3
CONFIG_CUT_OFF_TC_ID=3

# Data sizes
CONFIG_ID_SIZE=2
CONFIG_SEQ_COUNTER_SIZE=16
CONFIG_RTC_SIZE=17
CONFIG_GNSS_SIZE=55
CONFIG_TEMP_SIZE=96
CONFIG_ALT_SIZE=24
CONFIG_BITFLIP_SIZE=172
CONFIG_RADIATION_SIZE=9984
CONFIG_TC_SIZE=3
CONFIG_CRC_SIZE=16

CONFIG_HOUSEKEEPING_PACKET_SIZE=63
CONFIG_HOUSEKEEPING_DATA_SIZE=466
CONFIG_BITFLIP_PACKET_SIZE=32
CONFIG_BITFLIP_DATA_SIZE=224
CONFIG_RADIATION_PACKET_SIZE=1255
CONFIG_RADIATION_DATA_SIZE=10001
CONFIG_ACKNOWLEDGEMENT_PACKET_SIZE=6
CONFIG_ACKNOWLEDGEMENT_DATA_SIZE=37
CONFIG_TC_PACKET_SIZE = 5
CONFIG_TC_DATA_SIZE = 19

# Buffer configuration
CONFIG_MAX_TC_BUFFER_SIZE=20
CONFIG_MAX_RADIATION_BUFFER_SIZE=350


# UART configuration
CONFIG_UART_BAUD_RATE=115200
CONFIG_UART_NUM=1
CONFIG_LOG_DEFAULT_LEVEL_NONE=y
CONFIG_TX_PIN=9
CONFIG_RX_PIN=10
CONFIG_UART_BUF_SIZE=1500

# Ethernet configuration
CONFIG_HOST_IP_ADDR="192.168.0.165"
CONFIG_HOST_PORT=8080
CONFIG_ETH_MDC_GPIO=23
CONFIG_ETH_MDIO_GPIO=18
CONFIG_ETH_PHY_RST_GPIO=5
CONFIG_ETH_PHY_ADDR=1
CONFIG_CONNECTED_BIT=1
CONFIG_ETH_CONNECTION_TMO_MS=10000
CONFIG_ETH_BUFFER_SIZE=128
CONFIG_KEEPALIVE_ENABLED=y
CONFIG_KEEPALIVE_IDLE=5
CONFIG_KEEPALIVE_INTERVAL=5
CONFIG_KEEPALIVE_COUNT=3
CONFIG_USE_STATIC_IP=y

#SPI configs
CONFIG_ETH_SPI_CLOCK_MHZ = 4
CONFIG_ETH_SPI_HOST = 1

# SD card pins configuration - avoid conflicts with Ethernet
#CONFIG_SD_CS_PIN=5
#CONFIG_SD_MOSI_PIN=23
#CONFIG_SD_MISO_PIN=19
#CONFIG_SD_SCK_PIN=18
#CONFIG_SD_CARD_DETECT_PIN=-1
CONFIG_ENABLE_SD_STORAGE=y

# Ethernet PHY configuration
CONFIG_ETH_PHY_SI_PIN=13
CONFIG_ETH_PHY_SO_PIN=12
CONFIG_ETH_PHY_SCK_PIN=14
CONFIG_ETH_PHY_CS_PIN=15
```

## MCU_platformio/sdkconfig.defaults
```kconfig
# Use internal Ethernet MAC (not SPI)
CONFIG_ETH_USE_SPI_ETHERNET=n

# Internal EMAC + IP101 PHY settings
CONFIG_EXAMPLE_USE_INTERNAL_ETHERNET=y
CONFIG_EXAMPLE_ETH_PHY_IP101=y
CONFIG_EXAMPLE_ETH_PHY_ADDR=1
CONFIG_EXAMPLE_ETH_PHY_RST_GPIO=5
CONFIG_EXAMPLE_ETH_MDC_GPIO=23
CONFIG_EXAMPLE_ETH_MDIO_GPIO=18
```

## ethernet_test/main/Kconfig
```kconfig
menu "default packet config"

config HOUSEKEEPING_PACKET_SIZE
    int "Housekeeping packet size"
    default 256

config HOUSEKEEPING_DATA_SIZE
    int "Housekeeping data size"
    default 1024

config BITFLIP_PACKET_SIZE
    int "Bitflip packet size"
    default 256

config BITFLIP_DATA_SIZE
    int "Bitflip data size"
    default 1024

config RADIATION_PACKET_SIZE
    int "Radiation packet size"
    default 256

config RADIATION_DATA_SIZE
    int "Radiation data size"
    default 1024

config ACKNOWLEDGEMENT_PACKET_SIZE
    int "Acknowledgement packet size"
    default 7

config ACKNOWLEDGEMENT_DATA_SIZE
    int "Acknowledgement data size"
    default 3

endmenu
```

## ethernet_test/sdkconfig.defaults
```kconfig
CONFIG_HOUSEKEEPING_PACKET_SIZE=32
CONFIG_HOUSEKEEPING_DATA_SIZE=28

CONFIG_BITFLIP_PACKET_SIZE=32
CONFIG_BITFLIP_DATA_SIZE=28

CONFIG_RADIATION_PACKET_SIZE=32
CONFIG_RADIATION_DATA_SIZE=28

CONFIG_ACKNOWLEDGEMENT_PACKET_SIZE=7
CONFIG_ACKNOWLEDGEMENT_DATA_SIZE=3
```
